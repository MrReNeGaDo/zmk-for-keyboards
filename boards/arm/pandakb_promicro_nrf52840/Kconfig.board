## boards/arm/pandakb_promicro_nrf52840/Kconfig.board
```kconfig
config BOARD_PANDAKB_PROMICRO_NRF52840
    bool "PandaKB ProMicro nRF52840"
    depends on SOC_NRF52840_QFAA
    help
      PandaKB ProMicro nRF52840 board
```

## boards/arm/pandakb_promicro_nrf52840/Kconfig.defconfig
```kconfig
if BOARD_PANDAKB_PROMICRO_NRF52840

config BT
    default y

config SERIAL
    default y

config USB_DEVICE_STACK
    default y

config BT_CTLR
    default y

endif
```
